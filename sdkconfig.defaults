## sdkconfig.defaults
```kconfig
CONFIG_BLINK_LED_GPIO=y
CONFIG_BLINK_GPIO=8
CONFIG_ESP_DEFAULT_CPU_FREQ_MHZ_240=y
# default:
# CONFIG_ESP_DEFAULT_CPU_FREQ_MHZ_240 is not set
# default:
CONFIG_ESP_DEFAULT_CPU_FREQ_MHZ=240
```
